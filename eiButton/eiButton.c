#include "eiButton.h"
#include "MDR32F9Qx_config.h"
#include <MDR32F9Qx_rst_clk.h>
#include <MDR32F9Qx_port.h>
#include <MDR32F9Qx_timer.h>
#include "systick.h"
#include "clks/clks.h"

volatile double scale_fall=0;

static double lpoint_dec=0;
static uint32_t lpoint_hex=0;

uint16_t bframe=0;

void xSendPresence(void);
uint8_t uiGetByte(void);
void xSendByte(uint8_t byte);

static uint8_t id_ibutton[8]={0x0c,0xb3,0x4d,0x4c,0x00,0x00,0x00,0xac};

static uint8_t sertificate[8192]={
0x3F,0x7C,0x14,0x00,0x45,0x53,0x4A,0x00,0xB6,0x1F,0xDE,0x55,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0x00,
0x00,0x4D,0x45,0x00,0x00,0x00,0x00,0x00,0x00,0x4D,0x45,0x00,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0x45,
0x00,0x00,0x00,0x00,0x00,0x00,0x4D,0x45,0x00,0x00,0x00,0x00,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0x00,
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0x37,0x53
};

void xSetPoint(double point)
{
	lpoint_dec = point;
	lpoint_hex = lpoint_dec*1000/12.5;
}

uint16_t addr=0;
uint8_t break_trans_cert=0;
void Timer2_IRQHandler(void)
{
	
			if((MDR_TIMER2->STATUS & (1<<TIMER_STATUS_ETR_FE_EVENT_Pos )) && (!(MDR_PORTD->RXTX & (1<<5))))			//fall signal				
			{
				SysTickStart(lpoint_hex);
				SysTick->VAL=0;
			}
			
			if((MDR_TIMER2->STATUS & (1<<TIMER_STATUS_ETR_RE_EVENT_Pos )) && (MDR_PORTD->RXTX & (1<<5)))				//raise signal
			{
				SysTickStop();
				if(!break_trans_cert)Ticks++;
				scale_fall = Ticks * lpoint_dec;
				Ticks=0;
			}

			break_trans_cert=0;																																								//clear flag break trassmit
		
		if((scale_fall>=MIN_RESET) && (scale_fall<=MAX_RESET))																							//it is reset. It is not standart 1-Wire
		{
			xSendPresence();																																									//it send presenсe signal to 1-wire bus
			
			while((MDR_PORTD->RXTX & (1<<5))){static uint32_t cnt=0; cnt++;}																	//wait byte begin
			MDR_PORTD->FUNC &= ~(3<<10);																																			//port func
			bframe = uiGetByte();			
			if(bframe==0x33)																																									//transsmit id
			{
				for(int i=0;i<8;xSendByte(id_ibutton[i++]));	
			}
			
			if(bframe==0xCC)
			{				
				bframe= uiGetByte();
				if(bframe==0xf0)
				{				
					addr = uiGetByte();
					addr |=(uiGetByte()<<8); 
					//transsmit data in 1-Wire
					int i=0;
					while(!break_trans_cert)
					{
						xSendByte(sertificate[addr+i++]);
					}
				}		
			}
		}
	scale_fall=0;
	MDR_PORTD->FUNC |= (3<<10);																																						//override func PORTD5
	MDR_TIMER2->STATUS = 0;
	NVIC_ClearPendingIRQ(Timer2_IRQn);
}

void xSwichPD5_Out(void)
{
	MDR_PORTD->OE |= (1<<5);												//out
	MDR_PORTD->FUNC &= ~(3<<10);										//port func
	MDR_PORTD->ANALOG |= (1<<5);										//digital
	MDR_PORTD->PWR |= (1<<11);											//fast speed
	MDR_PORTD->PD |= (1<<5);												//open drain
	MDR_PORTD->PULL = 0x0000;
	MDR_PORTD->GFEN =0x0000;
}

void xSwichPD5_IN(void)
{	
	MDR_PORTD->OE &= ~(1<<5);												//out
	MDR_PORTD->FUNC &= ~(3<<10);										//port func
}

void xSendPresence(void)
{
	wait_us(1);																																												
	xSwichPD5_Out();
	MDR_PORTD->RXTX &= ~(1<<5);
	wait_us(200);
	MDR_PORTD->RXTX |= (1<<5);
	xSwichPD5_IN();	
}

uint8_t uiGetByte(void)
{
	uint8_t nbit=0, sbit=0, t=0;
	uint8_t frame =0;
	
	while(nbit<8)
	{
		__asm("NOP\n\t");
//		MDR_PORTA->RXTX &= ~(1<<0);
		if((MDR_PORTD->RXTX & (1<<5)))
		{
			while(MDR_PORTD->RXTX & (1<<5));
			wait_us(14);
		}
		else wait_us(28);																		//wait_us(17); wait_us(28);
		__asm("NOP\n\t");
//		MDR_PORTA->RXTX |= (1<<0);
		sbit = (MDR_PORTD->RXTX & (1<<5))>>5;
		frame |= (sbit<<nbit++);
		if((MDR_PORTD->RXTX & (1<<5)))
			while(sbit)
				{
					t= wait_us(1);
					sbit = (MDR_PORTD->RXTX & (1<<5))>>5 & t;
				}
		else while(!sbit)
				{
					t= wait_us(1);
					sbit = (MDR_PORTD->RXTX & (1<<5))>>5 & t;
				}
	}
	return frame;
}

void xBreakTransByte(void)
{
		break_trans_cert=1; 
		Ticks=2;
		SysTickStart(lpoint_hex);
		SysTick->VAL=0;		
}

void xSendByte(uint8_t byte)
{
	uint8_t nbit=0; //uint16_t cnt=0;
	while(nbit<8)
	{
//		__asm("NOP\n\t");
		MDR_PORTA->RXTX &= ~(1<<0);
//		__asm("NOP\n\t");
		
		while(MDR_PORTD->RXTX & (1<<5));										//wait for begin start frame
		
		MDR_PORTD->OE |= (1<<5);														//out
		MDR_PORTD->PD |= (1<<5);														//open drain				
		
		MDR_PORTA->RXTX |= (1<<0);
		MDR_PORTD->RXTX = ((byte & 0x01)<<5);
		wait_us(35);
		if((MDR_PORTD->RXTX & (1<<5))!=((byte & 0x01)<<5))	//check for reset
		{	
			xBreakTransByte();
			return;
		}
		wait_us(6);
		MDR_PORTD->OE &= ~(1<<5);														//in
		MDR_PORTD->PD &= ~(1<<5);														//open drain	
		wait_us(8);
		if(!(MDR_PORTD->RXTX & (1<<5)))											//check for reset again
		{
			xBreakTransByte();
			return;			
		}
		wait_us(30);
		byte >>= 1;nbit++;
		
	}
}
